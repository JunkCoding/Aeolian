## components/espfs/Kconfig
```kconfig
#ESP-IDF Kconfig configuration file. Not used for ESP8266 RTOS/non-RTOS SDKs.

menu "libespfs"

config ESPFS_ENABLED
    bool "espfs"
    help
        Select this option to enable libespfs and show the submodule with libespfs configuration

config ESPFS_MAX_PARTITIONS
        int "Maximum Number of Partitions"
        default 1
        range 1 10
        help
                Define maximum number of partitions that can be mounted.

config ESPFS_HTMLDIR
        string "Directory (on the build machine) where the static files served by the webserver are"
        depends on ESPFS_ENABLED
        default "html/"

endmenu
```

## main/Kconfig.projbuild
```kconfig
menu "AXRGB Configuration"

  config USE_BOTH_CORES
    bool "Use both cores for all tasks"
    default false
    help
      Use both cores for all tasks or bind LEDs to core1 and all other tasks to core0.
      Depending on the number of LEDs and the loop delay, some flickering may be apparent when using both cores for all tasks.

  config USE_TASK_WDT
    bool "Use watchdog timer"
    default true
    help
      Use watchdog timer to monitor tasks

  choice LOG_LEVEL
    prompt "Application log level"
    default APP_LOG_WARN
    help
      No help

    config APP_LOG_NONE
      bool "None"

    config APP_LOG_ERROR
      bool "Error"

    config APP_LOG_WARN
      bool "Warn"

    config APP_LOG_INFO
      bool "Info"

    config APP_LOG_DEBUG
      bool "Debug"

    config APP_LOG_VERBOSE
      bool "Verbose"
  endchoice
  config APP_LOG_LEVEL
    int
    default 0 if APP_LOG_NONE
    default 1 if APP_LOG_ERROR
    default 2 if APP_LOG_WARN
    default 3 if APP_LOG_INFO
    default 4 if APP_LOG_DEBUG
    default 5 if APP_LOG_VERBOSE

  config LOG_MAX_LINES
    int "Maximum number of log entries to store in the buffer"
    default 100
    help
      This is the maximum number of log lines that can be stored in RAM for retreival via the web interface or other means.

  config LIGHT_PIN
    int "Security Light Output Pin"
    default 23
    help
      The output pin for turning on/off an external security light

  choice TARGET_DEVICE
    prompt "Idiosyncratic Target"
    default AXRGB_DEV_DEBUG
    help
      No help

    config AXRGB_DEV_CARAVAN
      bool "Caravan"

    config AXRGB_DEV_DEBUG
      bool "Debug"

    config AXRGB_DEV_SEGGER
      bool "SEGGER"

    config AXRGB_DEV_OLIMEX
      bool "OLIMEX"

    config AXRGB_DEV_TTGO
      bool "TTGO Audio"

    config AXRGB_DEV_WORKSHOP
      bool "Workshop"

    config AXRGB_DEV_ROCKET
      bool "Rocket Launch"
  endchoice
    config TARGET_DEVICE_STR
      string
      default "Caravan"    if AXRGB_DEV_CARAVAN
      default "Debug"      if AXRGB_DEV_DEBUG
      default "Segger"     if AXRGB_DEV_SEGGER
      default "Olimex"     if AXRGB_DEV_OLIMEX
      default "TTGO_Audio" if AXRGB_DEV_TTGO
      default "Workshop"   if AXRGB_DEV_WORKSHOP
      default "WSA"        if AXRGB_DEV_ROCKET
    config RGB_ORDER
      bool
      default n            if AXRGB_DEV_OLIMEX
      default n            if AXRGB_DEV_TTGO
      default y
    config USING_JTAG
      bool
      default y             if AXRGB_DEV_OLIMEX
      default y             if AXRGB_DEV_SEGGER
      default n
    config DEBUG
      bool
      default y             if AXRGB_DEV_DEBUG
      default y             if AXRGB_DEV_OLIMEX
      default y             if AXRGB_DEV_SEGGER
      default n
    config CCTV
      bool
      default y             if AXRGB_DEV_DEBUG
      default n

    if USING_JTAG
      config APPTRACE_DEST_JTAG
    endif

  menu "Wireless STA Configuration"
    config DEFAULT_STA_SSID
      string "SSID"
      default ""
      help
        SSID of the wireless AP we should connect to

    config DEFAULT_STA_PASS
      string "Password"
      default ""
      help
        Password of the wireless AP we should connect to

  endmenu

  menu "WS2812 Configuration"

    config WS2812_PIN
      int "WS2812 Output Pin"
      default 22
      help
        Select output data pin for WS2812 lights

  config USE_RMT_INTERRUPT
    bool "Update LEDs using RMT interrupt"
    default false
    help
      Update the LEDs with an alternative method using interrupts.

  config LED_LOOP_US
    int "The minium duration of one display cycle"
    default 14400
    help
      This is the minimum display cycle in milliseconds.
      Use this to sync multiple devices together. Keep in mind, updating one RGB LED
      takes around 30us. Updating 400 takes around 12ms, depending on other running
      tasks and which RMT method you are using.

    config PIXELS
      int "Pixel Count"
      default 380
      help
        Number of pixels in WS2812 string

    config SHOW_STARS
      bool "Enable Flashes"
      default true
      help
        Enable overlaid sparkles (flashes) to enhance the patterns

    choice DEFAULT_DIM
      prompt "Default Brightness"
      default AXRGB_DIM_MED
      help
        Default WS2812 brightness level

      config AXRGB_DIM_MIN
        bool "Minimum"
      config AXRGB_DIM_LOW
        bool "Low"
      config AXRGB_DIM_MED
        bool "Medium"
      config AXRGB_DIM_HIGH
        bool "High"
      config AXRGB_DIM_MAX
        bool "Max"
    endchoice

    config DEFAULT_DIM
      int
      default 0 if AXRGB_DIM_MAX
      default 1 if AXRGB_DIM_HIGH
      default 2 if AXRGB_DIM_MED
      default 3 if AXRGB_DIM_LOW
      default 4 if AXRGB_DIM_MIN

  endmenu

  menu "Motion Detection"
    config MOTION_DETECTION
      bool "Enable Motion Detection"
      default "n"
      help
        Enable gpio inputs triggers for motion detection devices

      config MOTION_INPUT_1
        depends on MOTION_DETECTION
        int "GPIO Input 1"
        default 35

      config MOTION_INPUT_2
        depends on MOTION_DETECTION
        int "GPIO Input 2"
        default 33

      config MOTION_INPUT_3
        depends on MOTION_DETECTION
        int "GPIO Input 3"
        default 25

      config MOTION_INPUT_4
        depends on MOTION_DETECTION
        int "GPIO Input 4"
        default 26

  endmenu

  menu "Web Server Configuration"

  config LED_GPIO
    int "Led GPIO number"
      range 0 34
      default 2
      help
        GPIO number (IOxx) to blink on and off.
        Some GPIOs are used for other purposes (flash connections, etc.) and cannot be used to blink.
        GPIOs 35-39 are input-only so cannot be used as outputs.

  config HTTPD_USE_ASYNC
    bool "HTTPD uses async sockets"
      default true
      help
        The builtin HTTP server uses async sockets rather than a more standard approach.

  endmenu

endmenu
```

## sdkconfig.defaults
```kconfig
CONFIG_APP_LOG_INFO=y
CONFIG_APP_LOG_LEVEL=3

CONFIG_LOG_MAX_LINES=200
CONFIG_LED_LOOP_US=20000
CONFIG_SHOW_STARS=y
CONFIG_HTTPD_USE_ASYNC=y

CONFIG_LWIP_IRAM_OPTIMIZATION=y
CONFIG_LWIP_MAX_SOCKETS=16
CONFIG_LWIP_SO_RCVBUF=y
CONFIG_LWIP_IP4_REASSEMBLY=y
CONFIG_LWIP_TCPIP_RECVMBOX_SIZE=64
CONFIG_LWIP_DHCP_OPTIONS_LEN=128
CONFIG_LWIP_DHCPS_MAX_STATION_NUM=4
CONFIG_LWIP_TCP_RTO_TIME=3000
CONFIG_LWIP_TCPIP_TASK_STACK_SIZE=4096
CONFIG_LWIP_SNTP_MAX_SERVERS=3
CONFIG_LWIP_DHCP_GET_NTP_SRV=y
CONFIG_LWIP_DHCP_MAX_NTP_SERVERS=3
CONFIG_LWIP_HOOK_TCP_ISN_NONE=y

CONFIG_HTTPD_LOG_PURGE_DATA=y
CONFIG_HTTPD_WS_SUPPORT=y
CONFIG_HTTPD_MAX_REQ_HDR_LEN=1024

CONFIG_BOOTLOADER_COMPILER_OPTIMIZATION_PERF=y
CONFIG_BOOTLOADER_LOG_LEVEL_ERROR=y
CONFIG_BOOTLOADER_LOG_LEVEL=1
CONFIG_BOOTLOADER_SPI_WP_PIN=7
CONFIG_BOOTLOADER_WDT_DISABLE_IN_USER_CODE=y
CONFIG_BOOTLOADER_APP_ROLLBACK_ENABLE=y

CONFIG_COMPILER_OPTIMIZATION_PERF=y

CONFIG_ESPTOOLPY_FLASHMODE_QIO=y
CONFIG_ESPTOOLPY_FLASHFREQ_80M=y
CONFIG_ESPTOOLPY_FLASHFREQ="80m"
CONFIG_ESPTOOLPY_FLASHSIZE_4MB=y
CONFIG_ESPTOOLPY_FLASHSIZE="4MB"

CONFIG_PARTITION_TABLE_CUSTOM=y
CONFIG_PARTITION_TABLE_FILENAME="partitions.csv"
CONFIG_PARTITION_TABLE_OFFSET=0x11000

CONFIG_USE_BOTH_CORES=y
CONFIG_USE_TASK_WDT=y

CONFIG_ESP_MAIN_TASK_AFFINITY_NO_AFFINITY=y
CONFIG_ESP_MAIN_TASK_AFFINITY=0x7FFFFFFF
CONFIG_ESP_MINIMAL_SHARED_STACK_SIZE=4096
CONFIG_ESP_TIMER_INTERRUPT_LEVEL=3

CONFIG_MQTT_SKIP_PUBLISH_IF_DISCONNECTED=y
CONFIG_MQTT_REPORT_DELETED_MESSAGES=y
CONFIG_MQTT_USE_CUSTOM_CONFIG=y
CONFIG_MQTT_TCP_DEFAULT_PORT=1883
CONFIG_MQTT_BUFFER_SIZE=2048
CONFIG_MQTT_TASK_STACK_SIZE=6144
CONFIG_MQTT_TASK_PRIORITY=5
CONFIG_MQTT_OUTBOX_EXPIRED_TIMEOUT_MS=30000
CONFIG_MQTT_PROTOCOL_5=y

CONFIG_PTHREAD_TASK_PRIO_DEFAULT=2
CONFIG_PTHREAD_TASK_STACK_SIZE_DEFAULT=2048

CONFIG_SPI_FLASH_ENABLE_COUNTERS=y
CONFIG_SPI_FLASH_DANGEROUS_WRITE_FAILS=y
CONFIG_SPI_FLASH_ERASE_YIELD_TICKS=10
CONFIG_SPI_FLASH_WRITE_CHUNK_SIZE=4096
CONFIG_SPIFFS_MAX_PARTITIONS=1

CONFIG_UNITY_ENABLE_64BIT=y

CONFIG_SPI_MASTER_IN_IRAM=y
CONFIG_SPI_SLAVE_IN_IRAM=y
CONFIG_UART_ISR_IN_IRAM=y
CONFIG_RMT_ISR_IRAM_SAFE=y
#CONFIG_RMT_RECV_FUNC_IN_IRAM=y

CONFIG_WIFI_PROV_SCAN_MAX_ENTRIES=50
CONFIG_ESP32_WIFI_STATIC_RX_BUFFER_NUM=12
CONFIG_ESP32_WIFI_DYNAMIC_RX_BUFFER_NUM=12
CONFIG_ESP32_WIFI_STATIC_TX_BUFFER=y
CONFIG_ESP32_WIFI_TX_BUFFER_TYPE=0
CONFIG_ESP32_WIFI_STATIC_TX_BUFFER_NUM=16
CONFIG_ESP32_WIFI_CSI_ENABLED=y
CONFIG_ESP32_WIFI_TX_BA_WIN=10
CONFIG_ESP32_WIFI_RX_BA_WIN=10
CONFIG_ESP32_WIFI_SOFTAP_BEACON_MAX_LEN=932
CONFIG_ESP_WIFI_SLP_IRAM_OPT=y

CONFIG_ESPFS_ENABLED=y
CONFIG_ESPFS_HTMLDIR="html/"

CONFIG_FREERTOS_HZ=500
CONFIG_FREERTOS_CHECK_STACKOVERFLOW_NONE=y
CONFIG_FREERTOS_THREAD_LOCAL_STORAGE_POINTERS=16
CONFIG_FREERTOS_USE_TRACE_FACILITY=y
CONFIG_FREERTOS_USE_STATS_FORMATTING_FUNCTIONS=y
CONFIG_FREERTOS_VTASKLIST_INCLUDE_COREID=y
CONFIG_FREERTOS_GENERATE_RUN_TIME_STATS=y
CONFIG_FREERTOS_RUN_TIME_STATS_USING_ESP_TIMER=y

CONFIG_HAL_ASSERTION_DISABLE=y

CONFIG_HEAP_TRACING_OFF=y
CONFIG_HEAP_POISONING_DISABLED=y
CONFIG_OPTIMIZATION_ASSERTIONS_DISABLED=y
CONFIG_OPTIMIZATION_ASSERTION_LEVEL=0

CONFIG_LOG_DEFAULT_LEVEL_ERROR=y
CONFIG_LOG_DEFAULT_LEVEL=1
CONFIG_LOG_MAXIMUM_LEVEL=1
CONFIG_LOG_TIMESTAMP_SOURCE_SYSTEM=y
CONFIG_LOG_BOOTLOADER_LEVEL_ERROR=y
CONFIG_LOG_BOOTLOADER_LEVEL=1

CONFIG_APP_ROLLBACK_ENABLE=y
CONFIG_FLASHMODE_QIO=y
CONFIG_WS_BUFFER_SIZE=2048
CONFIG_WS_DYNAMIC_BUFFER=y
CONFIG_WARN_WRITE_STRINGS=y
CONFIG_ESP32_RTC_CLOCK_SOURCE_INTERNAL_8MD256=y
CONFIG_IPC_TASK_STACK_SIZE=2048
CONFIG_ESP32S2_PANIC_SILENT_REBOOT=y
CONFIG_SYSTEM_EVENT_TASK_STACK_SIZE=4096
CONFIG_MAIN_TASK_STACK_SIZE=4096
CONFIG_INT_WDT_TIMEOUT_MS=1000
CONFIG_TASK_WDT_PANIC=y
CONFIG_TIMER_TASK_STACK_DEPTH=1536
CONFIG_TCPIP_TASK_STACK_SIZE=4096
CONFIG_ESP32_PTHREAD_TASK_STACK_SIZE_DEFAULT=2048


CONFIG_GPIO_CTRL_FUNC_IN_IRAM=y
CONFIG_UNITY_ENABLE_COLOR=y
CONFIG_JSMN_STATIC=y
```
